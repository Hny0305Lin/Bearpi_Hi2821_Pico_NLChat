## application/Kconfig
```kconfig
#===============================================================================
# @brief    Kconfig file.
# Copyright (c) @CompanyNameMagicTag 2023-2023. All rights reserved.
#===============================================================================

config SAMPLE_ENABLE
    bool
    prompt "Enable Sample."
    default n
    help
        This option means support Samples.

if SAMPLE_ENABLE
osource "application/samples/Kconfig"
endif
```

## application/samples/peripheral/pdm_amic/Kconfig
```kconfig
#===============================================================================
# @brief    Kconfig file.
# Copyright (c) @CompanyNameMagicTag 2023-2023. All rights reserved.
#===============================================================================
config ADC_USE_PIN1
    int
    prompt "Choose ADC USE pin1."
    depends on SAMPLE_SUPPORT_PDM_AMIC
    default 30

config ADC_USE_PIN2
    int
    prompt "Choose ADC USE pin2."
    depends on SAMPLE_SUPPORT_PDM_AMIC
    default 31

config ADC_PIN_MODE
    int
    prompt "Choose ADC pin mode."
    default 0
    depends on SAMPLE_SUPPORT_PDM_AMIC

config PDM_TRANSFER_LEN_BY_DMA
    int
    prompt "Set the length of transfer by DMA."
    default 32
    help
        This option means the length of transfer by DMA.

config PDM_MAX_RECORD_DATA_SIZE
    hex
    prompt "Set the max recorder size by PDM."
    default 7800
    help
        This option means the max recorder size by PDM.
```

## protocol/Kconfig
```kconfig
choice
    prompt "Select sle ble support"
    default SUPPORT_SLE_BLE_CENTRAL_DEFAULT
    config SUPPORT_SLE_BLE_CENTRAL_DEFAULT
        bool "Select sle ble central default."
    config SUPPORT_SLE_BLE_PERIPHERAL
        bool "Select sle ble peripheral."
    config SUPPORT_SLE_PERIPHERAL
        bool "Select sle peripheral."
    config SUPPORT_SLE_CENTRAL
        bool "Select sle central."
    config SUPPORT_BLE_PERIPHERAL
        bool "Select ble peripheral."
endchoice

config SLE_BLE_RELEASE_SUPPORT
    bool
    prompt "Enable sle ble release."
    default n
    help
        This option means close sle ble log.

config SLE_BLE_SUPPORT
    string
    default "sle-ble-peripheral" if (SUPPORT_SLE_BLE_PERIPHERAL && !SLE_BLE_RELEASE_SUPPORT)
    default "sle-ble-peripheral-release" if (SUPPORT_SLE_BLE_PERIPHERAL && SLE_BLE_RELEASE_SUPPORT)
    default "sle-peripheral" if (SUPPORT_SLE_PERIPHERAL && !SLE_BLE_RELEASE_SUPPORT)
    default "sle-peripheral-release" if (SUPPORT_SLE_PERIPHERAL && SLE_BLE_RELEASE_SUPPORT)
    default "sle-central" if (SUPPORT_SLE_CENTRAL && !SLE_BLE_RELEASE_SUPPORT)
    default "sle-central-release" if (SUPPORT_SLE_CENTRAL && SLE_BLE_RELEASE_SUPPORT)
    default "ble-peripheral" if (SUPPORT_BLE_PERIPHERAL && !SLE_BLE_RELEASE_SUPPORT)
    default "ble-peripheral-release" if (SUPPORT_BLE_PERIPHERAL && SLE_BLE_RELEASE_SUPPORT)

config BT_SLE_ONLY
    bool
    default y if (SUPPORT_SLE_PERIPHERAL || SUPPORT_SLE_CENTRAL)

config BT_BLE_ONLY
    bool
    default y if (SUPPORT_BLE_PERIPHERAL)


menu "bt_host"
    comment "Config bluetooth."
    osource "protocol/bt/host/Kconfig"
endmenu

config SUPPORT_NFC
    bool
    prompt "Enable nfc support."
    default n
    help
        This option means enable nfc support.
```
